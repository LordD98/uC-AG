;
; SoftwarePWM+ADC_Assembly.asm
;
; Created: 21.07.2017 13:00:55
; Author : s-del
;

.include "m16def.inc"

; Replace with your application code
start:
	LDI r16, LOW(RAMEND)		;	init the stack pointer
	OUT SPL, r16				;
	LDI r16, HIGH(RAMEND)		;
	OUT SPH, r16				;
	rcall init					;

main:
	IN r16, PORTC				;	toggle PORTC
	COM r16						;
	OUT PORTC, r16				;
	rcall delay					;	delay 500ms (with rcall and ret should take 500ms + 7T)
	rjmp main					;	loop

init:
	LDI r16, 0xFF				;	PORTC as output
	OUT DDRC, r16				;
	ret


; Generated by delay loop calculator
; at http://www.bretmulvey.com/avrdelay.html
;
; Delay 7 372 800 cycles
; 500ms at 14.745600 MHz
; 1 Cycle takes 1T := 1/F_CPU
delay:					; 3*T
    ldi  r18, 38		; Rout	outer register
    ldi  r19, 103		; Rmid	mid register
    ldi  r20, 246		; Rin	inner register
L1: dec  r20			; 1T							; erst 246 mal,		; erst 103 mal,		; erst
    brne L1				; 1T if false, else 2T			; dann je 256 mal	; dann je			; 38
    dec  r19			; 1T												; 256 mal			; mal,
    brne L1				; 1T if false, else 2T								;					; dann
    dec  r18			; 1T																	; 255
    brne L1				; 1T if false, else 2T													; mal
    rjmp PC+1			; 2T

	ret					; 4T