#include <avr/io.h>


void setup();
void UART_putByte(uint8_t byte);
uint8_t UART_getByte();


int main()
{
	//Ruft setup
	setup();

	//////////////////////////////////////////////////////////////////
	//Teil 3
//
	////Endlosschleife die '#' ausgibt
	//while(1)
	//{
		//UART_putByte('#');
	//}
	
	//Teil 3 Ende
	///////////////////////////////////////////////////////////////////

	//////////////////////////////////////////////////////////////////
	//Teil 5.2

	//Endlosschleife die Daten vom UART liest und auf PORTC ausgibt
	//while(1)
	//{
		//PORTC = ~UART_getByte();
	//}
	//Teil 5.2 Ende
	///////////////////////////////////////////////////////////////////

	//////////////////////////////////////////////////////////////////
	//Teil 6

	//Endlosschleife die Daten vom UART liest und direkt wieder zurück schreibt
	while(1)
	{
		UART_putByte(UART_getByte());
	}
	//Teil 6 Ende
	///////////////////////////////////////////////////////////////////


	return 0;
}


void setup()
{
	//////////////////////////////////////////////////////////////////
	//Teil 1

	//UBRRL und UBRRH mit dem Wert aus dem Datenblatt laden
	UBRRL = 95;
	//->Keine Parität
	//->1 Stop Bit
	//->8 Bits an Daten

	//UCSRA laden


	//UCSRB laden
	UCSRB |= 1<< RXEN | 1<<TXEN;
	
	//UCSRC laden
	UCSRC |= 1 << URSEL | 3 << UCSZ0;

	//Teil 1 Ende
	///////////////////////////////////////////////////////////////////

	//////////////////////////////////////////////////////////////////
	//Teil 5.1

	//PORTC als Output
	DDRC = 0xFF;
	PORTC = 0xFF;
	//Teil 5.1 Ende
	///////////////////////////////////////////////////////////////////
}

void UART_putByte(uint8_t byte){
	//////////////////////////////////////////////////////////////////
	//Teil 2

	//Warten bis UDR leer ist -> Bit in UCSRA
	while (!(UCSRA & (1<<UDRE)));
		
	
	//Daten in UDR laden
	UDR = byte;

	//Teil 2 Ende
	///////////////////////////////////////////////////////////////////
}

uint8_t UART_getByte(){
	//////////////////////////////////////////////////////////////////
	//Teil 4

	//Warten bis Empfangen komplett ist -> Bit in UCSRA
	while (!(UCSRA & (1<<RXC)));

	//Daten aus UDR lesen
	return UDR;

	//Teil 4 Ende
	///////////////////////////////////////////////////////////////////
}
